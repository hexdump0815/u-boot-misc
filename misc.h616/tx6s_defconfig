## misc.h616/tx6s_defconfig
```kconfig
CONFIG_ARM=y
CONFIG_ARCH_SUNXI=y
CONFIG_SPL=y
CONFIG_DRAM_SUN50I_H616_READ_CALIBRATION=y
CONFIG_DRAM_SUN50I_H616_UNKNOWN_FEATURE=y
CONFIG_MACH_SUN50I_H616=y
CONFIG_MMC0_CD_PIN="PI16"
CONFIG_R_I2C_ENABLE=y
CONFIG_DEFAULT_DEVICE_TREE="sun50i-h616-tx6s"
# CONFIG_SYS_MALLOC_CLEAR_ON_INIT is not set
CONFIG_SPL_I2C_SUPPORT=y
CONFIG_SUN8I_EMAC=y
CONFIG_I2C3_ENABLE=y
```

## misc.rk3318/h96max_rk3318/Kconfig
```kconfig
if TARGET_H96MAX_RK3318

config SYS_BOARD
	default "h96max_rk3318"

config SYS_VENDOR
	default "rockchip"

config SYS_CONFIG_NAME
	default "evb_rk3328"

config BOARD_SPECIFIC_OPTIONS # dummy
	def_bool y

endif
```
